## configs/386root_defconfig
```kconfig
# Architecture
BR2_i386=y
BR2_x86_i386=y

# Toolchain
BR2_TOOLCHAIN_BUILDROOT=y
BR2_TOOLCHAIN_BUILDROOT_VENDOR="386root"
BR2_TOOLCHAIN_BUILDROOT_UCLIBC=y
BR2_GCC_VERSION_4_9_X=y
BR2_BINUTILS_VERSION_2_24_X=y

# Kernel
BR2_LINUX_KERNEL=y
BR2_LINUX_KERNEL_CUSTOM_GIT=y
BR2_LINUX_KERNEL_CUSTOM_REPO_URL="https://github.com/vmunix486/386linux"
BR2_LINUX_KERNEL_CUSTOM_REPO_VERSION="main"
BR2_LINUX_KERNEL_USE_CUSTOM_CONFIG=y
BR2_LINUX_KERNEL_CUSTOM_CONFIG_FILE="board/386root/linux-3.7.config"
BR2_LINUX_KERNEL_BZIMAGE=y
BR2_LINUX_KERNEL_INSTALL_TARGET=y
BR2_LINUX_KERNEL_PATCH="board/386root/kernel-fix-no-pie.patch"

# Kernel headers (3.7 series to match the kernel)
BR2_KERNEL_HEADERS_AS_KERNEL=y
BR2_PACKAGE_HOST_LINUX_HEADERS_CUSTOM_3_7=y

# System
BR2_TARGET_GENERIC_HOSTNAME="386root"
BR2_TARGET_GENERIC_ISSUE="Welcome to 386root"
BR2_TARGET_GENERIC_GETTY_PORT="ttyS0"
BR2_TARGET_GENERIC_GETTY_BAUDRATE_115200=y
BR2_TARGET_GENERIC_GETTY_TERM="vt100"
BR2_SYSTEM_DHCP="eth0"
BR2_TARGET_ENABLE_ROOT_LOGIN=y
BR2_TARGET_GENERIC_ROOT_PASSWD=""
BR2_SYSTEM_BIN_SH_BUSYBOX=y
BR2_ROOTFS_DEVICE_CREATION_DYNAMIC_DEVTMPFS=y

# Filesystem
BR2_TARGET_ROOTFS_EXT2=y
BR2_TARGET_ROOTFS_EXT2_4=y
BR2_TARGET_ROOTFS_EXT2_EXTRA_BLOCKS=4096
BR2_TARGET_ROOTFS_EXT2_EXTRA_INODES=256

# Bootloader (syslinux for MBR boot)
BR2_TARGET_SYSLINUX=y
BR2_TARGET_SYSLINUX_LEGACY_BIOS=y
BR2_TARGET_SYSLINUX_MBR=y
```
